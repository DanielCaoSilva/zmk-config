/*
 * Copyright (c) 2021-2022 The ZMK Contributors
 *
 * SPDX-License-Identifier: MIT
 */

#include "hillside46.dtsi" 




&kscan0 {
    col-gpios
        = <&xiao_d 1 GPIO_ACTIVE_HIGH>
        , <&xiao_d 2 GPIO_ACTIVE_HIGH>
        , <&xiao_d 3 GPIO_ACTIVE_HIGH>
        , <&xiao_d 4 GPIO_ACTIVE_HIGH>
        , <&xiao_d 5 GPIO_ACTIVE_HIGH>
        , <&xiao_d 6 GPIO_ACTIVE_HIGH>
        ;
};

//OLD BELOW
//&kscan0 {
//    col-gpios
//        = <&xiao_d 4 GPIO_ACTIVE_HIGH>
//        , <&xiao_d 5 GPIO_ACTIVE_HIGH>
//        , <&xiao_d 10 GPIO_ACTIVE_HIGH>
//        , <&xiao_d 9 GPIO_ACTIVE_HIGH>
//        , <&xiao_d 8 GPIO_ACTIVE_HIGH>
//        ;
//};


//&kscan0 {
//    col-gpios
//        = <&pro_micro 19 GPIO_ACTIVE_HIGH> // col0 in the schematic
//        , <&pro_micro 18 GPIO_ACTIVE_HIGH> // col1 in the schematic
//       , <&pro_micro 15 GPIO_ACTIVE_HIGH> // col2 in the schematic
//        , <&pro_micro 14 GPIO_ACTIVE_HIGH> // col3 in the schematic
//        , <&pro_micro 16 GPIO_ACTIVE_HIGH> // col4 in the schematic
//        , <&pro_micro 10 GPIO_ACTIVE_HIGH> // col5 in the schematic
//        ;
//};

//&left_encoder {
//    status = "okay";
//};